AUTOSAR XML (schema 00046)
package /ActiveEcuC
  module config MemPool
    os_test (MemModule):
      BswModuleRef = /ActiveEcuC/Os
      OsApplicationRef = /ActiveEcuC/Os/SystemApplication_Core1
      MemPoolRef = /ActiveEcuC/MemPool/os_test_mempool_{0..2}
    3 x MemPool, all with MemAlignment=16, CoreID=Core1:
      os_test_mempool_0: MemBlockCount=35, MemBlockSize=128, MemType=GLOBAL
      os_test_mempool_1: MemBlockCount=35, MemBlockSize=128, MemType=GLOBAL
      os_test_mempool_2: MemBlockCount=19, MemBlockSize=256, MemType=AUTOMATIC
    rte_test (MemModule): BswModuleRef=/ActiveEcuC/Rte, OsApplicationRef=/ActiveEcuC/Os/SystemApplication_Core0, MemPoolRef=/ActiveEcuC/MemPool/os_test_mempool_0
