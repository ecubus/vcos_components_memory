AUTOSAR XML (schema 00046)
package /AUTOSAR/EcucDefs
  module definition Memmap [0..1]: variants pre-compile  # Configuration of the Memmap module. / 概述：Memmap 模块的配置
    container MemmapLayer [1..16]  # Defines the name of the memmap layer provided. / 概述：MemmapLayer 配置项用于指定内存映射中的软件层级，允许多个内存映射软件层级。 注意：用户必须配置至少一个内存映射软件层级，并存在唯一一个内部软件层级，作为内部底层的软件层级。
      boolean InternalLayer: scope=ECU, set at pre-compile, default-value=false  # true: the layer is defined as the internal memmap layer. / 概述：InternalLayer说明该层级作为内部底层的内存映射软件层级。 注意：必须存在唯一一个InternalLayer。 | false: the layer is not used as an internal memmap layer.
    container MemmapModule [0..65535]  # Defines the name of a memmap module. / 概述：MemmapModule 配置项用于指定内存映射中的用户自定义模块的模块名称。 注意：用户可自定义多个内存映射模块，操作系统会为每一个模块生成对应的模块头文件供用户使用。
      boolean MemmapUseCalibration: scope=ECU, set at pre-compile, default-value=false  # true: generate calibration mapping for the module. / 概述：MemmapUseCalibration说明该模块需要生成calibration段。 注意：如果在不需要calibration段的情况下，打开了这个选项，会造成冗余代码。 | false: the module doesn't require calibration mapping.
      reference MemmapApplicationRef [0..512]: scope=ECU, multiplicity set at pre-compile, set at pre-compile, destination=OsApplication  # Defines the name of the applications the module is related to. / 概述：MemmapApplicationRef 配置项用于指定模块相关的applications。 注意：用户可以配置关联多个application，根据无关联，单关联或多关联，会产生不一样的内存映射宏供用户使用。
      reference MemmapUseLayer: multiplicity set at pre-compile, set at pre-compile, destination=MemmapLayer  # Defines the name of the memmap layer the module is related to. / 概述：MemmapUseLayer 配置项用于指定模块关联的内存映射软件层级。 注意：用户必须将配置的内存映射模块定义到一个内存映射软件层级上。
