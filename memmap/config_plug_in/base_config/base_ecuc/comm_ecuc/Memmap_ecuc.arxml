AUTOSAR XML (schema 00046)
package /ActiveEcuC
  module config Memmap
    fw (MemmapLayer): InternalLayer=true
    bsw (MemmapLayer): InternalLayer=false
