AUTOSAR XML (schema 00046)
package /ActiveEcuC
  module config NvM: implementation-config-variant=VARIANT-PRE-COMPILE, module-description=NvM_Impl
    NvMCommonVendorParams: NvMCfgCbkIncludeList=(unset)
    NvMConfigBlock (NvMBlockDescriptor):
      NvMBlockUseAutoValidation = false
      NvMBlockUseCrc = true
      NvMBlockUseCRCCompMechanism = false
      NvMBlockUseSetRamBlockStatus = true
      NvMBlockUseSyncMechanism = false
      NvMBlockWriteProt = false
      NvMBswMBlockStatusInformation = false
      NvMCalcRamBlockCrc = true
      NvMResistantToChangedSw = true
      NvMSelectBlockForFirstInitAll = false
      NvMSelectBlockForReadAll = true
      NvMSelectBlockForWriteAll = true
      NvMStaticBlockIDCheck = false
      NvMWriteBlockOnce = false
      NvMWriteVerification = false
      NvMBlockJobPriority = 127
      NvMMaxNumOfReadRetries = 0
      NvMMaxNumOfWriteRetries = 0
      NvMNvBlockBaseNumber = 1
      NvMNvBlockLength = 2
      NvMNvBlockNum = 1
      NvMNvramBlockIdentifier = 1
      NvMNvramDeviceId = 0
      NvMRomBlockNum = 0
      NvMWriteVerificationDataSize = 1
      NvMAutoBlockLength = (unset)
      NvMBlockCrcType = NVM_CRC16
      NvMBlockManagementType = NVM_BLOCK_NATIVE
      NvMInitBlockCallback = NULL
      NvMReadRamBlockFromNvCallback = NULL
      NvMSingleBlockCallback = 
      NvMWriteRamBlockToNvCallback = NULL
      NvMBlockHeaderInclude = NULL
      NvMRamBlockDataAddress = nvm_config_block_ram_block
      NvMRomBlockDataAddress = NULL
    NvMCommon:
      NvMBswMMultiBlockJobStatusInformation = false
      NvMDevErrorDetect = false
      NvMDrvModeSwitch = false
      NvMDynamicConfiguration = false
      NvMJobPrioritization = false
      NvMPollingMode = false
      NvMSetRamBlockStatusApi = true
      NvMVersionInfoApi = true
      NvMMainFunctionPeriod = 0.05
      NvMCompiledConfigId = 1
      NvMCrcNumOfBytes = 65535
      NvMDatasetSelectionBits = 0
      NvMRepeatMirrorOperations = 0
      NvMSizeImmediateJobQueue = 1
      NvMSizeStandardJobQueue = 10
      NvMApiConfigClass = NVM_API_CONFIG_CLASS_3
      NvMMultiBlockCallback = 
