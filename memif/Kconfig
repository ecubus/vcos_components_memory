## memif/Kconfig
```kconfig
config MODULE_MEMIF
    bool "mem memif support"
    default n
	---help---
		Enable the MODULE_MEMIF
```

## nvm/Kconfig
```kconfig
config MODULE_NVM
    bool "mem nvm support"
    default n
	---help---
		Enable the MODULE_NVM
```
